## build/Kconfig/boards/Kconfig.defconfig
```kconfig
# Load Zephyr board defconfig descriptions.
osource "C:/Users/Javi/zephyrproject/zephyr/boards/st/nucleo_wl55jc/Kconfig.defconfig"
```

## build/Kconfig/boards/Kconfig.nucleo_wl55jc
```kconfig
# Load board Kconfig descriptions.
osource "C:/Users/Javi/zephyrproject/zephyr/boards/st/nucleo_wl55jc/Kconfig.nucleo_wl55jc"
```

## build/Kconfig/boards/Kconfig.sysbuild
```kconfig
# Load Sysbuild board Kconfig descriptions.
osource "C:/Users/Javi/zephyrproject/zephyr/boards/st/nucleo_wl55jc/Kconfig.sysbuild"
```
